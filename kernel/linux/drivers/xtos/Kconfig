## kernel/linux/drivers/xtos/Kconfig
```kconfig
# SPDX-License-Identifier: GPL-2.0

menu "XTOS Real-Time Operating System"

source "drivers/xtos/bci/Kconfig"

endmenu
```

## kernel/linux/drivers/xtos/bci/Kconfig
```kconfig
# SPDX-License-Identifier: GPL-2.0
#
# XTOS Real-Time Operating System Drivers
#

config XTOS_BCI
	tristate "XTOS BCI (Brain-Computer Interface) Framework"
	default n
	help
	  Core framework for BCI/EEG device drivers. Provides a unified
	  character-device interface and an internal ring buffer.

	  The framework does not create hardware or sample data by itself.
	  If unsure, say N.

config XTOS_BCI_OPENBCI
	tristate "OpenBCI Cyton serdev driver"
	depends on XTOS_BCI
	depends on SERIAL_DEV_BUS
	default n
	help
	  Serdev skeleton for OpenBCI Cyton. It only binds when firmware
	  describes an OpenBCI-compatible serdev device; it does not create
	  a serial device or emulate hardware.

config XTOS_BCI_DEBUG
	bool "XTOS BCI Debug Support"
	depends on XTOS_BCI
	help
	  Enable debug messages for BCI drivers. This adds overhead
	  but helps troubleshooting device issues.

	  If unsure, say N.
```

## kernel/linux/kernel/sched/xtos/Kconfig
```kconfig
# SPDX-License-Identifier: GPL-2.0

config XTOS_SCHED
	tristate "XTOS optional scheduler helper"
	default n
	help
	  Build the XTOS O(1) priority-queue helper as a loadable module or
	  built-in component.  This does not replace Linux's sched_class and
	  does not alter normal task scheduling.  It is intended for explicit
	  integrations that own the xtos_task control blocks.

	  If unsure, say N.
```
